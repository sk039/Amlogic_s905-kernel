## drivers/amlogic/wifi/Kconfig
```kconfig
comment "Amlogic Wifi Driver"

menuconfig AMLOGIC_WIFI
	boolean "WiFi support"
	default n
	help
		select y to support wifi

if AMLOGIC_WIFI
config BCMDHD_USE_STATIC_BUF
	boolean "broadcom wifi static buff support"
	depends on AMLOGIC_WIFI
	default n

config AMLOGIC_WIFI_DUMMY
	tristate "Amlogic SDIO WiFi turn on and rescan module"
	depends on AMLOGIC_WIFI
	default m

source "drivers/amlogic/wifi/bcmdhd/Kconfig"

endif # AMLOGIC_WIFI
```
